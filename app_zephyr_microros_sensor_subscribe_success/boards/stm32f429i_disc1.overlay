/*
 * Copyright (c) 2019 Linaro Limited
 *
 * SPDX-License-Identifier: Apache-2.0
 */

&spi5 {
	cs-gpios = <&gpiof 6 GPIO_ACTIVE_LOW>;
	adxl372@0 {
		compatible = "adi,adxl372";
		reg = <0>;
		spi-max-frequency = <8000000>;
		label = "ADXL372";
		int1-gpios = <&gpioe 6 GPIO_ACTIVE_HIGH>;
	};
};
