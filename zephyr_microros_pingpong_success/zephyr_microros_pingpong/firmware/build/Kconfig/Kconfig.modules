## zephyr_microros_pingpong_success/zephyr_microros_pingpong/firmware/build/Kconfig/Kconfig.modules
```kconfig
menu "hal_nordic (/home/nuc01/zephyr_microros_pingpong/firmware/zephyrproject/modules/hal/nordic)"
osource "$(ZEPHYR_HAL_NORDIC_KCONFIG)"
config ZEPHYR_HAL_NORDIC_MODULE
	bool
	default y
endmenu
menu "sof (/home/nuc01/zephyr_microros_pingpong/firmware/zephyrproject/modules/audio/sof)"
osource "/home/nuc01/zephyr_microros_pingpong/firmware/zephyrproject/modules/audio/sof/zephyr/Kconfig"
config ZEPHYR_SOF_MODULE
	bool
	default y
endmenu
```

## zephyr_microros_pingpong_success/zephyr_microros_pingpong/firmware/build/Kconfig/Kconfig.shield
```kconfig
osource "/home/nuc01/zephyr_microros_pingpong/firmware/zephyrproject/zephyr/boards/shields/*/Kconfig.shield"
osource "/home/nuc01/zephyr_microros_pingpong/firmware/zephyrproject/zephyr/boards/shields/*/Kconfig.shield"
```

## zephyr_microros_pingpong_success/zephyr_microros_pingpong/firmware/build/Kconfig/Kconfig.shield.defconfig
```kconfig
osource "/home/nuc01/zephyr_microros_pingpong/firmware/zephyrproject/zephyr/boards/shields/*/Kconfig.defconfig"
osource "/home/nuc01/zephyr_microros_pingpong/firmware/zephyrproject/zephyr/boards/shields/*/Kconfig.defconfig"
```

## zephyr_microros_pingpong_success/zephyr_microros_pingpong/firmware/build/Kconfig/Kconfig.soc
```kconfig
osource "/home/nuc01/zephyr_microros_pingpong/firmware/zephyrproject/zephyr/soc/$(ARCH)/*/Kconfig.soc"
```
